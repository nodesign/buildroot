## defconfig
```kconfig
BR2_mips=y
BR2_mips_32r2=y
BR2_CCACHE=y
BR2_KERNEL_HEADERS_3_12=y
BR2_TOOLCHAIN_BUILDROOT_EGLIBC=y
BR2_BINUTILS_VERSION_2_24=y
BR2_GCC_VERSION_4_8_X=y
BR2_PACKAGE_HOST_GDB=y
BR2_LINUX_KERNEL=y
BR2_LINUX_KERNEL_CUSTOM_GIT=y
BR2_LINUX_KERNEL_CUSTOM_REPO_URL="git@github.com:drasko/linux.git"
BR2_LINUX_KERNEL_CUSTOM_REPO_VERSION="carambola2"
BR2_LINUX_KERNEL_DEFCONFIG="ath79"
BR2_TARGET_ROOTFS_CPIO_LZO=y
BR2_TARGET_ROOTFS_INITRAMFS=y
# BR2_TARGET_ROOTFS_TAR is not set
```
